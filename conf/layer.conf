## conf/layer.conf
```bitbake
# We have a conf and classes directory, add to BBPATH
BBPATH .= ":${LAYERDIR}"

# We have recipes-* directories, add to BBFILES
BBFILES += "${LAYERDIR}/recipes-*/*/*.bb \
            ${LAYERDIR}/recipes-*/*/*.bbappend"

BBFILE_COLLECTIONS += "meta-myrpi"
BBFILE_PATTERN_meta-myrpi = "^${LAYERDIR}/"
BBFILE_PRIORITY_meta-myrpi = "100"

LAYERDEPENDS_meta-myrpi = "core"
LAYERSERIES_COMPAT_meta-myrpi = "kirkstone"

IMAGE_INSTALL:append = " \
    connman \
    connman-client \
    openssh-sftp-server \
    sudo \
    python3 \
    python3-pip \
    rpi-gpio \
    raspi-gpio \
    libstdc++ \
"

IMAGE_FEATURES:append = " \
    ssh-server-openssh \
"

# systemd settings
DISTRO_FEATURES:append = " systemd"
VIRTUAL-RUNTIME_init_manager = "systemd"
DISTRO_FEATURES_BACKFILL_CONSIDERED = "sysvinit"
VIRTUAL-RUNTIME_initscripts = ""
IMX_DEFAULT_DISTRO_FEATURES:append = " systemd"

# for c++
TOOLCHAIN_TARGET_TASK:append = " libstdc++-staticdev"

# enable mini uart
ENABLE_UART = "1"

INHERIT += "buildhistory"
BUILDHISTORY_COMMIT = "1"

IMAGE_INSTALL:append = " \
    procps \
    bash \
    util-linux \
    coreutils \
    psmisc \
    netcat \
    net-tools \
    coreutils \
    vim \
    perf \
    strace \
    sysstat \
    iputils \
    sysfsutils \
    nfs-utils \
    glibc-utils \
    hdparm \
    e2fsprogs \
    e2fsprogs-badblocks \
    e2fsprogs-e2fsck \
    e2fsprogs-mke2fs \
    e2fsprogs-tune2fs \
    elfutils \
    file \
    iperf3 \
    iozone3 \
    lmbench \
    netperf \
    bridge-utils \
    inetutils \
    inetutils-ping \
    inetutils-ping6 \
    inetutils-hostname \
    inetutils-ifconfig \
    inetutils-logger \
    inetutils-traceroute \
    inetutils-ftp \
    inetutils-ftpd \
    inetutils-telnet \
    inetutils-telnetd \
    inetutils-inetd \
    tcpdump \
    tcpreplay \
    memtester \
    dhrystone \
    fio \
    rsync \
    gdb \
    gdbserver \
"

IMAGE_INSTALL:append = " \
      packagegroup-core-buildessential \
      packagegroup-core-nfs-server \
      packagegroup-core-tools-debug \
"

IMAGE_INSTALL:append = " lttng-tools lttng-modules lttng-ust"
```
